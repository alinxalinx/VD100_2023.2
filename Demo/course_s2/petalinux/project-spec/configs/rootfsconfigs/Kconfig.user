## Demo/course_s2/petalinux/project-spec/configs/rootfsconfigs/Kconfig.user
```kconfig
menu "user packages " 
config axlcd  
	 bool "axlcd"
	 help
	
config mdiorw  
	 bool "mdiorw"
	 help
	
config test-apps  
	 bool "test-apps"
	 help
	
endmenu
```
